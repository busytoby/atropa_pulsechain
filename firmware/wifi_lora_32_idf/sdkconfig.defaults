## firmware/wifi_lora_32_idf/sdkconfig.defaults
```kconfig
# Target board details
CONFIG_IDF_TARGET="esp32s3"

# System and frequency configurations
CONFIG_ESP32S3_DEFAULT_CPU_FREQ_240=y
CONFIG_ESP_DEFAULT_CPU_FREQ_MHZ_240=y

# FreeRTOS configurations
CONFIG_FREERTOS_HZ=1000

# SPIFFS (LittleFS fallback) support
CONFIG_SPIFFS_MAX_PARTITIONS=3

# C++ exceptions support
CONFIG_COMPILER_CXX_EXCEPTIONS=y

# mbedTLS customizations (ensure MPI algorithms are enabled)
CONFIG_MBEDTLS_ASYMMETRIC_CONTENT_LEN=y

# Custom partition table
CONFIG_PARTITION_TABLE_CUSTOM=y
CONFIG_PARTITION_TABLE_CUSTOM_FILENAME="partitions.csv"
CONFIG_PARTITION_TABLE_FILENAME="partitions.csv"

# Enable native USB-Serial/JTAG console for input/output
CONFIG_ESP_CONSOLE_USB_SERIAL_JTAG=y
# CONFIG_ESP_CONSOLE_UART_DEFAULT is not set

# Enable WebSocket support in HTTP server
CONFIG_HTTPD_WS_SUPPORT=y
```
