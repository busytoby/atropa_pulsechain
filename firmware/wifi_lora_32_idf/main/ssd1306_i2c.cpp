#include "ssd1306_i2c.h"
#include "driver/gpio.h"
#include "driver/i2c_master.h"
#include "esp_log.h"
#include "freertos/FreeRTOS.h"
#include "freertos/task.h"
#include <string.h>
#include <stdlib.h>

static const char *TAG = "SSD1306";
static i2c_master_bus_handle_t bus_handle = NULL;
static i2c_master_dev_handle_t dev_handle = NULL;

// Standard ASCII Font 8x8 (Characters 32 to 127)
static const uint8_t font8x8[96][8] = {
    {0x00, 0x00, 0x00, 0x00, 0x00, 0x00, 0x00, 0x00}, // (space)
    {0x00, 0x00, 0x00, 0x4F, 0x00, 0x00, 0x00, 0x00}, // !
    {0x00, 0x00, 0x07, 0x00, 0x07, 0x00, 0x00, 0x00}, // "
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    {0x7F, 0x7F, 0x7F, 0x7F, 0x7F, 0x7F, 0x7F, 0x7F}  // (solid block)
};

static esp_err_t ssd1306_write_cmd(uint8_t cmd) {
    if (!dev_handle) return ESP_ERR_INVALID_STATE;
    uint8_t buf[2] = {0x00, cmd};
    return i2c_master_transmit(dev_handle, buf, sizeof(buf), pdMS_TO_TICKS(50));
}

static esp_err_t ssd1306_write_data(const uint8_t *data, size_t len) {
    if (!dev_handle) return ESP_ERR_INVALID_STATE;
    uint8_t *buf = (uint8_t *)malloc(len + 1);
    if (!buf) return ESP_ERR_NO_MEM;
    buf[0] = 0x40;
    memcpy(buf + 1, data, len);
    esp_err_t ret = i2c_master_transmit(dev_handle, buf, len + 1, pdMS_TO_TICKS(50));
    free(buf);
    return ret;
}

esp_err_t ssd1306_init(int sda_pin, int scl_pin, int rst_pin, int vext_pin) {
    // 1. Setup Vext and Reset Pin
    gpio_config_t io_conf = {};
    io_conf.intr_type = GPIO_INTR_DISABLE;
    io_conf.mode = GPIO_MODE_OUTPUT;
    io_conf.pin_bit_mask = (1ULL << rst_pin) | (1ULL << vext_pin);
    io_conf.pull_down_en = GPIO_PULLDOWN_DISABLE;
    io_conf.pull_up_en = GPIO_PULLUP_DISABLE;
    gpio_config(&io_conf);

    // Power display ON (Active Low for Vext on Heltec)
    gpio_set_level((gpio_num_t)vext_pin, 0);
    
    // Hardware Reset SSD1306
    gpio_set_level((gpio_num_t)rst_pin, 0);
    vTaskDelay(pdMS_TO_TICKS(50));
    gpio_set_level((gpio_num_t)rst_pin, 1);
    vTaskDelay(pdMS_TO_TICKS(50));

    // 2. Initialize Modern I2C Master Driver
    i2c_master_bus_config_t bus_config = {};
    bus_config.i2c_port = I2C_NUM_0;
    bus_config.sda_io_num = (gpio_num_t)sda_pin;
    bus_config.scl_io_num = (gpio_num_t)scl_pin;
    bus_config.clk_source = I2C_CLK_SRC_DEFAULT;
    bus_config.glitch_ignore_cnt = 7;
    bus_config.flags.enable_internal_pullup = true;

    esp_err_t ret = i2c_new_master_bus(&bus_config, &bus_handle);
    if (ret != ESP_OK) {
        ESP_LOGE(TAG, "Failed to create I2C master bus: %s", esp_err_to_name(ret));
        return ret;
    }

    i2c_device_config_t dev_config = {};
    dev_config.dev_addr_length = I2C_ADDR_BIT_LEN_7;
    dev_config.device_address = SSD1306_I2C_ADDRESS;
    dev_config.scl_speed_hz = 400000;

    ret = i2c_master_bus_add_device(bus_handle, &dev_config, &dev_handle);
    if (ret != ESP_OK) {
        ESP_LOGE(TAG, "Failed to add I2C device: %s", esp_err_to_name(ret));
        return ret;
    }

    // 3. Send Initialization Sequence
    uint8_t init_cmds[] = {
        0xAE, // Display Off
        0xD5, 0x80, // Clock Div
        0xA8, 0x3F, // Multiplex Ratio (64px)
        0xD3, 0x00, // Display Offset
        0x40,       // Start Line (0)
        0x8D, 0x14, // Charge Pump (Enable)
        0x20, 0x02, // Memory Addressing Mode: Page addressing
        0xA1,       // Segment Re-map (Horizontal Flip)
        0xC8,       // COM Output Scan Direction (Vertical Flip)
        0xDA, 0x12, // COM Pins HW Config
        0x81, 0xCF, // Contrast (CF)
        0xD9, 0xF1, // Pre-charge Period
        0xDB, 0x40, // VCOMH Deselect Level
        0xA4,       // Entire Display On (Resume from RAM)
        0xA6,       // Normal Display (Not Inverted)
        0xAF        // Display On
    };

    for (size_t i = 0; i < sizeof(init_cmds); i++) {
        ssd1306_write_cmd(init_cmds[i]);
    }
    
    ESP_LOGI(TAG, "SSD1306 display initialized successfully using driver/i2c_master.");
    return ESP_OK;
}

void ssd1306_clear() {
    uint8_t zero_buf[128] = {0};
    for (uint8_t page = 0; page < 8; page++) {
        ssd1306_write_cmd(0xB0 + page); // Set page address
        ssd1306_write_cmd(0x00);        // Set low column address
        ssd1306_write_cmd(0x10);        // Set high column address
        ssd1306_write_data(zero_buf, 128);
    }
}

void ssd1306_draw_string(uint8_t page, uint8_t col, const char *str) {
    if (page >= 8 || col >= 128) return;
    
    ssd1306_write_cmd(0xB0 + page);
    ssd1306_write_cmd(col & 0x0F);
    ssd1306_write_cmd(0x10 | ((col >> 4) & 0x0F));

    size_t len = strlen(str);
    for (size_t i = 0; i < len; i++) {
        char c = str[i];
        if (c < 32 || c > 127) c = ' '; // Map to space if out of range
        
        // Font index (offset by 32 ASCII space)
        uint8_t font_idx = c - 32;
        ssd1306_write_data(font8x8[font_idx], 8);
    }
}

void ssd1306_power_save(bool enable) {
    ssd1306_write_cmd(enable ? 0xAE : 0xAF);
}
