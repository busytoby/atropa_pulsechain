    {
        .fourcc_str = "REV4",
        .opcode_signature = 0x52455634,
        .title = "CPMTOMIE-REVIEW-PHASE4-CORPS",
        .theorem_descriptions = {
            "Theorem 1 Proof",
            "Theorem 2 Proof",
            "Theorem 3 Proof",
            "Theorem 4 Proof",
            "Theorem 5 Proof"
        }
    },
    {
        .fourcc_str = "TMEX",
        .opcode_signature = 0x544D4558,
        .title = "TOMIC-EXTENDED-GENERATIVE-LINGUISTICS-CORPS",
        .theorem_descriptions = {
            "McCawley Extensive Lexical Transformations Invariance",
            "Fillmore Systematic Subjectivization of Underlying Cases",
            "Patient/Experiencer/Locative Non-Agentive Role Soundness",
            "Recursive Phrase-Marker Tree Derivation Continuity",
            "Generative Semantics Deep-to-Surface Gap Bridge Gating"
        }
    },
    {
        .fourcc_str = "TOMI",
        .opcode_signature = 0x544F4D49,
        .title = "OLGA-MISESKA-TOMIC-GENERATIVE-GRAMMAR-CORPS",
        .theorem_descriptions = {
            "Underlying Deep Structure to Surface Structure Bijectivity",
            "Fillmore Case Grammar (Agent/Patient/Experiencer) Invariance",
            "Transformational Generative Grammar Transition Operations",
            "Semantic Meaning Conservation Across Surface Transformations",
            "Universal Grammar SKELETON Fieldata Token Representation"
        }
    },
    {
        .fourcc_str = "DUAL",
        .opcode_signature = 0x4455414C,
        .title = "CPMTOMIE-LYAPUNOV-DUALITY-CORPS",
        .theorem_descriptions = {
            "Lower algebraic barrier (restitution to Totient Zero)",
            "Upper open phase space (unbounded exploration capacity)",
            "Lyapunov as non-dissipative envelope protecting openness",
            "Formal synthesis of closure preserving open innovation",
            "Theorem 5 Proof"
        }
    },
    {
        .fourcc_str = "CPCS",
        .opcode_signature = 0x43504353,
        .title = "CPMTOMIE-CST-TANGIBLE-AFFORDANCE-CORPS",
        .theorem_descriptions = {
            "Prompt Fatigue Elimination",
            "Ishii Tangible Affordance Dual Physicality",
            "Neurodynamical Divergent Ideation Stability",
            "Auditory/Haptic Tactile Commutation",
            "Sovereign CP/M-Tomie CST Tangible Affordance Grand Seal"
        }
    },
    {
        .fourcc_str = "HAMR",
        .opcode_signature = 0x48414D52,
        .title = "LAGRANGIAN-HAMILTONIAN-BALL-ROLLING-CORPS",
        .theorem_descriptions = {
            "Euler-Lagrange Equations with Nonholonomic Multipliers",
            "Symplectic Hamiltonian Phase Space Vector Field",
            "Invariant Poisson Bracket Lie Algebra Commutator",
            "Rayleigh Dissipation Minimal Action Principle",
            "Sovereign Phase Space Rolling Closure"
        }
    },
    {
        .fourcc_str = "QANN",
        .opcode_signature = 0x51414E4E,
        .title = "QUANTUM-ANNEALING-BOLTZMANN-SPIN-CORPS",
        .theorem_descriptions = {
            "Transverse-Field Ising Spin Glass Hamiltonian Mapping",
            "Non-Local Quantum Barrier Tunneling Acceleration",
            "Adiabatic Spectral Gap Minimum Invariant Delta_min > 0",
            "Coprime Eigenstate Ground State Totient Resonance",
            "Quantum-to-Classical Boltzmann Thermal Equilibrium Recovery"
        }
    },
    {
        .fourcc_str = "WTNS",
        .opcode_signature = 0x57544E53,
        .title = "CPMTOMIE-WITNESS-CORPS",
        .theorem_descriptions = {
            "Self-contained binary payload as Curry-Howard witness",
            "Platform-independent cross-channel communicability",
            "3-term recurrence deterministic verification",
            "Finite step termination without non-computable claims",
            "Theorem 5 Proof"
        }
    },
    {
        .fourcc_str = "LVTX",
        .opcode_signature = 0x4C565458,
        .title = "CPMTOMIE-LIVE-TELEMETRY-CORPS",
        .theorem_descriptions = {
            "Lockless SPSC Ring Buffer Bounded Latency",
            "Differentiable Recurrent Kalman State Observer",
            "STANAG 4586 Packet Stream Demux & Parity",
            "Deterministic Time-Triggered Dispatch Bound",
            "Theorem 5 Proof"
        }
    },
    {
        .fourcc_str = "RGFM",
        .opcode_signature = 0x5247464D,
        .title = "RAG-GFM-RETRIEVAL-GENERALIZED-FLOW-MODEL-CORPS",
        .theorem_descriptions = {
            "Retrieval Mutual Information Lower Bound",
            "Cross-Attention Conditioning Lipschitz Stability",
            "Knowledge Graph Topological Structural Invariance",
            "Generalized Flow Matching Vector Field Convergence",
            "Sovereign RAG-GFM Foundation Closure"
        }
    },
    {
        .fourcc_str = "CPPB",
        .opcode_signature = 0x43505042,
        .title = "CPMTOMIE-24TRUNK-PBX-CLAY-SOUND-SHAPE-CORPS",
        .theorem_descriptions = {
            "24-Trunk PBX Supervisory Tone Coupling",
            "Decadic Uniselector Step Frequency Rotation",
            "Multi-Modal Auditory/Haptic Synchrony",
            "DisplacementShader EDO-22 Microtonal Harmonics",
            "Sovereign PBX Clay Play Multi-Modal Grand Seal"
        }
    },
    {
        .fourcc_str = "TFPT",
        .opcode_signature = 0x54465054,
        .title = "GRAPH-PARTITIONING-3D-PARALLELISM-CORPS",
        .theorem_descriptions = {
            "1F1B Pipelined Execution Schedule Deadlock Freedom",
            "Column/Row-Parallel GEMM Bijective Factorization",
            "ZeRO-3 Optimizer & Gradient Memory Sharding Invariance",
            "Inter-Device Send/Recv Channel Matching & Race-Freedom",
            "Sharded Variable State Dynamic ZMM Address Resolution"
        }
    },
    {
        .fourcc_str = "CLAY",
        .opcode_signature = 0x434C4159,
        .title = "CLAYSCAPE-CERAMIC-DIGITAL-FABRICATION-CORPS",
        .theorem_descriptions = {
            "Clay Paste Viscoelastic Extrusion Continuity",
            "Non-Planar Quadtree Toolpath Geodesic Invariance",
            "Kiln Thermal Shrinkage Symplectic Relaxation",
            "Subsurface Glaze Spectral Radiance Scattering",
            "Sovereign ClayScape Ceramic Digital Fabrication Closure"
        }
    },
    {
        .fourcc_str = "ADCP",
        .opcode_signature = 0x41444350,
        .title = "AUTODIN-CAPSTAN-KERMIT-STREAM-CORPS",
        .theorem_descriptions = {
            "AUTODIN Packet Firewall Pre-Execution Bitmask Audit",
            "Dual Capstan Magnetic Tape Transport Track Parity",
            "Kermit Clean Packet Stream MARK 0x01 Framing",
            "EDSAC Initial Orders 1 Instruction Prefetch Firewall Gating",
            "Pure CCITT-CRC16 Frame Check Sequence Validation"
        }
    },
    {
        .fourcc_str = "TFCL",
        .opcode_signature = 0x5446434C,
        .title = "COLLECTIVE-PRIMITIVES-TENSORFLOW-ZORSE-CORPS",
        .theorem_descriptions = {
            "Ring AllGather Bijective Tensor Concatenation",
            "ReduceScatter Exact Local Invariant Reduction",
            "Root-to-Replica Deterministic Broadcast",
            "AllToAll Crossbar Non-Blocking Routing",
            "Collective Barrier Absolute Deadlock Freedom"
        }
    },
    {
        .fourcc_str = "ULOG",
        .opcode_signature = 0x554C4F47,
        .title = "UNIFORM-ATOMIC-ORDERED-LINEAR-LOGIC-CORPS",
        .theorem_descriptions = {
            "Uniform Cut-Elimination & Normalization Confluence",
            "Polarized Focused Proof Search & Monotone Inversion",
            "Non-Commutative Lambek Residual Monoid Adjunction",
            "Bounded Exponential Modality Modal Gating (! / ?)",
            "Canonical Ordered Linear Logic Proof Net Decidability"
        }
    },
    {
        .fourcc_str = "CAJL",
        .opcode_signature = 0x43414A4C,
        .title = "CPMTOMIE-PDF-CORPS",
        .theorem_descriptions = {
            "Linear Type Categorical Soundness",
            "Iteration to Linear Dynamical Systems",
            "Finite Subspace Observational Differentiability",
            "Denotational Preservation & Gradient Flow",
            "Theorem 5 Proof"
        }
    },
    {
        .fourcc_str = "CPLX",
        .opcode_signature = 0x43504C58,
        .title = "CPMTOMIE-EXTENDED-CLAY-PLAY-MORPHOLOGY-CORPS",
        .theorem_descriptions = {
            "Morphological Mold & Boundary Dilation Invariance",
            "Spatial Coordinate Topology & 2D Direct Manipulation Clustering",
            "Cognitive Momentum Preservation & Zero-Disruption Divergence",
            "Preinventive Structure Convergence & Bounded Exploration Variance",
            "Sovereign Extended Clay Play Multi-Modal Interaction Grand Seal"
        }
    },
    {
        .fourcc_str = "REV5",
        .opcode_signature = 0x52455635,
        .title = "CPMTOMIE-REVIEW-PHASE5-CORPS",
        .theorem_descriptions = {
            "Theorem 1 Proof",
            "Theorem 2 Proof",
            "Theorem 3 Proof",
            "Theorem 4 Proof",
            "Theorem 5 Proof"
        }
    },
    {
        .fourcc_str = "TF50",
        .opcode_signature = 0x54463530,
        .title = "TENSORFLOW-50-THEOREMS-GRAND-JUBILEE-CORPS",
        .theorem_descriptions = {
            "Cumulative Invariance across Theorems 1-45",
            "Unbroken Zorse Bessel Wave Envelope Continuity",
            "Multi-Agent LaSalle Attractor Restitution to Totient 0",
            "Strict Sub-Microsecond Dispatch Latency (< 1000ns)",
            "Complete 50-Theorem Formal Mathematical Synthesis"
        }
    },
    {
        .fourcc_str = "CP4B",
        .opcode_signature = 0x43503442,
        .title = "CPMTOMIE-4BOX-COAXIAL-CROSS-VM-INFERENCE-CORPS",
        .theorem_descriptions = {
            "4-Box Coaxial Bus Concurrency",
            "Direct Inference I/O Vector Dispatch",
            "Cross-VM Sovereign Boundary Isolation",
            "4-Box Telephonic Utility Inversion",
            "Sovereign 4-Box Coaxial Cross-VM Grand Seal"
        }
    },
    {
        .fourcc_str = "TFRW",
        .opcode_signature = 0x54465257,
        .title = "TF-GRAPPLER-GRAPH-REWRITES-ZORSE-CORPS",
        .theorem_descriptions = {
            "Grappler Constant Folding Semantic Equivalence",
            "Dead Code Elimination Soundness",
            "Common Subexpression Elimination (CSE) Invariance",
            "Auto-Layout NHWC/NCHW Bijective Memory Transpose",
            "Remapper Fused Conv2D+Bias+Activation Invariant"
        }
    },
    {
        .fourcc_str = "TFDG",
        .opcode_signature = 0x54464447,
        .title = "DIT-PAGEDATTN-MULTIMODAL-FUSION-CORPS",
        .theorem_descriptions = {
            "PagedAttention Block-Table KV-Cache Non-Fragmented Allocation",
            "Diffusion Transformer (DiT) Spatial Patch Latent Processing",
            "2D Spatial Rotary Position Embedding (2D-RoPE) Bijectivity",
            "AdaLN-Zero Adaptive LayerNorm Zero-Initialized Gating",
            "DeepSeek + Moondreams Multimodal Co-State Continuous Embedding"
        }
    },
    {
        .fourcc_str = "CPOS",
        .opcode_signature = 0x43504F53,
        .title = "CPMTOMIE-6STEP-CLAY-PLAY-OS-PIPELINE",
        .theorem_descriptions = {
            "6-Step CP/M-Tomie Event Dispatch Monotonicity",
            "Two-Layer 36-Byte FCB Fragment Locking",
            "TPA 0100H Non-Preferential Ingestion",
            "WinchesterMQ DisplacementShader Vector Invariance",
            "Sovereign CP/M-Tomie Clay Play OS Pipeline Grand Seal"
        }
    },
    {
        .fourcc_str = "GFMN",
        .opcode_signature = 0x47464D4E,
        .title = "CPMTOMIE-FULLY-FUNCTIONAL-GFM-NEURAL-NETWORK-CORPS",
        .theorem_descriptions = {
            "CP/M TPA 0100H Forward Activation Invariance",
            "ReBAR ZMM 512-Bit SIMD Message-Passing Concurrency",
            "Symplectic Weyl-Verlet FET Backpropagation Soundness",
            "Pure Binary Quadtree .dat.bin Flow Weight Durability",
            "Grand Sovereign CP/M-Tomie GFM Neural Network Engine Closure"
        }
    },
    {
        .fourcc_str = "CPYB",
        .opcode_signature = 0x43505942,
        .title = "CPMTOMIE-BIO-RINGTONE-YELLOWBOX-TELEPHONY",
        .theorem_descriptions = {
            ".bio Ringtone Acoustic Packaging",
            "PBX In-Band Yellow Box Dialup",
            "Soul & Saat Asset Commutation",
            "Non-Preferential Tone Matrix Invertibility",
            "Sovereign .bio Yellow Box Telephony Grand Seal"
        }
    },
    {
        .fourcc_str = "TFMP",
        .opcode_signature = 0x54464D50,
        .title = "MIXED-PRECISION-DYNAMO-ZORSE-CORPS",
        .theorem_descriptions = {
            "FP16/BF16 Exponent Mapping & Dynamic Range Invariance",
            "Adaptive Dynamic Loss Scaling Factor Scaling",
            "Kinetic Dynamo Torque Binding (Base^Signal mod Element)",
            "Subnormal Float Elimination & Underflow Gradient Preservation",
            "Master Weight FP32 Accumulation Numerical Equivalence"
        }
    },
    {
        .fourcc_str = "ABSN",
        .opcode_signature = 0x4142534E,
        .title = "CPMTOMIE-ABSENCE-PROOF-CORPS",
        .theorem_descriptions = {
            "Absence of unbounded trajectory divergence",
            "Absence of cross-contract state leakage",
            "Absence of infinite non-terminating limit cycles",
            "Absence of re-entrant memory corruption",
            "Theorem 5 Proof"
        }
    },
    {
        .fourcc_str = "GLSQ",
        .opcode_signature = 0x474C5351,
        .title = "RULE-15-TRIPARTITE-GLOSSARY-QUALIFICATION",
        .theorem_descriptions = {
            "Theorem 1 Proof",
            "Theorem 2 Proof",
            "Theorem 3 Proof",
            "Theorem 4 Proof",
            "Theorem 5 Proof"
        }
    },
    {
        .fourcc_str = "QUAL",
        .opcode_signature = 0x5155414C,
        .title = "ADVANCED-HARDWARE-PHYSICAL-QUALIFICATION",
        .theorem_descriptions = {
            "Theorem 1 Proof",
            "Theorem 2 Proof",
            "Theorem 3 Proof",
            "Theorem 4 Proof",
            "Theorem 5 Proof"
        }
    },
    {
        .fourcc_str = "DFIR",
        .opcode_signature = 0x44464952,
        .title = "STABLE-DIFFUSION-IR-PROCESS-CORPS",
        .theorem_descriptions = {
            "LWIR/MWIR Multi-Spectral Physical Latent Embedding",
            "Reverse Diffusion Atmospheric Turbidity & Scintillation Denoising",
            "Real-Time STANAG 4586 FLIR Sensor Stream Hardware Fusion",
            "Visible RGB to Thermal IR Cross-Modal Bijective Translation",
            "Radiometric Stefan-Boltzmann Blackbody Energy Conservation"
        }
    },
    {
        .fourcc_str = "CEXT",
        .opcode_signature = 0x43455854,
        .title = "CPMTOMIE-PDF-EXTRACT-CORPS",
        .theorem_descriptions = {
            "Theorem 1 Proof",
            "Theorem 2 Proof",
            "Theorem 3 Proof",
            "Theorem 4 Proof",
            "Theorem 5 Proof"
        }
    },
    {
        .fourcc_str = "TFKR",
        .opcode_signature = 0x54464B52,
        .title = "CUSTOM-OPKERNEL-DYNAMIC-ABI-ZORSE-CORPS",
        .theorem_descriptions = {
            "REGISTER_OP & OpKernelContext Strict Type Resolution",
            "Static Shape Inference & Output Rank Deduction Soundness",
            "vDSO & ReBAR Zero-Copy Vector Kernel Dispatch (<1000ns)",
            "Pure Clean-Room C-API Shared Interface Stability",
            "64-Byte AVX-512 / ZMM SIMD Vector Alignment"
        }
    },
    {
        .fourcc_str = "STNN",
        .opcode_signature = 0x53544E4E,
        .title = "CPMTOMIE-STANDARDS-NN-CORPS",
        .theorem_descriptions = {
            "Auncient spelling preserved",
            "Thread-safe dynamic interop only",
            "File bounds strictly under 68,000 bytes",
            "Soft body Verlet solvers for FET discharge only",
            "Strict .dat.bin quadtree storage format"
        }
    },
    {
        .fourcc_str = "IO1G",
        .opcode_signature = 0x494F3147,
        .title = "CPMTOMIE-IO1-GATING-CORPS",
        .theorem_descriptions = {
            "Theorem 1 Proof",
            "Theorem 2 Proof",
            "Theorem 3 Proof",
            "Theorem 4 Proof",
            "Theorem 5 Proof"
        }
    },
    {
        .fourcc_str = "FREV",
        .opcode_signature = 0x46524556,
        .title = "CPMTOMIE-FORMAL-REVIEW-CORPS",
        .theorem_descriptions = {
            "Theorem 1 Proof",
            "Theorem 2 Proof",
            "Theorem 3 Proof",
            "Theorem 4 Proof",
            "Theorem 5 Proof"
        }
    },
    {
        .fourcc_str = "CJES",
        .opcode_signature = 0x434A4553,
        .title = "CICS-JES-REALTIME-BATCH-PIPELINE-CORPS",
        .theorem_descriptions = {
            "CICS Real-Time Transaction Routing to JES Batch Bridge",
            "Hardware Plugboard Direct Signal Line Switching",
            "Lockless SPSC Ring FIFO Message Queue Soundness",
            "SwiGLU G_gate in [875..1000] Pipeline Stability",
            "DisplacementShader Vertex Math Synchronization (Rule 14)"
        }
    },
    {
        .fourcc_str = "CPTS",
        .opcode_signature = 0x43505453,
        .title = "CPMTOMIE-TOTIENT-CLAY-MASS-SCULPTING-CORPS",
        .theorem_descriptions = {
            "Totient-to-Clay Mass Mapping Invariance",
            "Clay Sculpting Deformation Homomorphism",
            "Non-Preferential Mass Conservation",
            "Spheroid ALU & DisplacementShader Surface Projection",
            "Sovereign CP/M-Tomie Totient Sculpting Grand Seal"
        }
    },
    {
        .fourcc_str = "INFL",
        .opcode_signature = 0x494E464C,
        .title = "SURFACE-CASE-MARKING-INFLECTION-CORPS",
        .theorem_descriptions = {
            "Overt Morphological Case Marking Bijectivity",
            "Prepositional Case Government and Rection",
            "Topic-Comment Functional Head Projection",
            "Contrastive Focus Prosodic Stress Realization",
            "Surface Inflectional Morphosyntax Closure"
        }
    },
    {
        .fourcc_str = "TFAD",
        .opcode_signature = 0x54464144,
        .title = "ADVANCED-TENSORFLOW-THEOREMS-ZORSE-CORPS",
        .theorem_descriptions = {
            "SavedModel Proto Signature Def & Asset Hermeticity",
            "TFLite FlatBuffer Zero-Copy Direct Memory Alignment",
            "Sub-linear O(sqrt(N)) Memory Gradient Checkpointing",
            "AdamW / L2 Weight Decay as Strict Lyapunov Energy Decay",
            "RaggedTensor Row-Splits & Value Bijective Mapping"
        }
    },
    {
        .fourcc_str = "TFZR",
        .opcode_signature = 0x54465A52,
        .title = "CPMTOMIE-TF-ZORSE-CORPS",
        .theorem_descriptions = {
            "TensorFlow DAG graph mapped to discrete Zorse 2D coordinates",
            "Continuous J0/J1 wave packet replaces discrete dot-product",
            "SwiGLU G_gate in [875..1000] BMRC stability",
            "Instantaneous ACID shadow restitution to Totient Zero",
            "Theorem 5 Proof"
        }
    },
    {
        .fourcc_str = "STDF",
        .opcode_signature = 0x53544446,
        .title = "MOUNTABLE-STANAG-MULTIMODAL-DIFFUSION-CORPS",
        .theorem_descriptions = {
            "Mountable STANAG 4586 Virtual Hardware Bus Interop",
            "DeepSeek Flash-Attention IO-Aware Blocked ZMM Tiling",
            "Moondreams Vision Patch Cross-Attention Conditioning",
            "Classifier-Free Guidance (CFG) Interpolation Stability",
            "Rectified Flow-Matching Straight-Line ODE Trajectories"
        }
    },
    {
        .fourcc_str = "TZBL",
        .opcode_signature = 0x545A424C,
        .title = "TOTIENT-BOLTZMANN-STATISTICAL-MECHANICS-CORPS",
        .theorem_descriptions = {
            "Microstate Multiplicity W = phi(N) Coprime Counting",
            "Boltzmann Entropy S = k_B * ln(phi(N))",
            "Canonical Partition Function Z_phi(T) = sum_{k in Coprimes} exp(-E_k / kT)",
            "Absolute Zero Ground State T->0 => phi(1)=1 => S=0 (Totient 0 Grounding)",
            "Maximum Entropy State Convergence under Galois Motzkin Prime"
        }
    },
    {
        .fourcc_str = "TFFP",
        .opcode_signature = 0x54464650,
        .title = "TF-PRIVACY-FEDERATED-SPARSE-CORPS",
        .theorem_descriptions = {
            "DP-SGD Rényi Differential Privacy (epsilon, delta) Bounding",
            "TFF Federated Averaging (FedAvg) Dynamic Co-State Consensus",
            "SparseTensor COO to CSR Coordinate Index Bijectivity",
            "TPU Embedding Table Dynamic Virtual Memory Paging",
            "SECP256k1 Signed Federated Participant Authentication"
        }
    },
    {
        .fourcc_str = "LYST",
        .opcode_signature = 0x4C595354,
        .title = "CPMTOMIE-LYAPUNOV-STD-CORPS",
        .theorem_descriptions = {
            "Discrete Positive Definiteness V(x) > 0",
            "Monotone Negative Step Decay Delta V(x) < 0",
            "Fixed-point contraction bounded by 7/8",
            "Termination in finite machine steps",
            "Theorem 5 Proof"
        }
    },
    {
        .fourcc_str = "RGFQ",
        .opcode_signature = 0x52474651,
        .title = "RAG-GFM-USDA-BINARY-QUADTREE-CORPS",
        .theorem_descriptions = {
            "USDA Prim Scenegraph to Graph Homomorphism",
            "Morton Z-Order Binary Quadtree Bijective Indexing",
            "Graph Laplacian Diffusion Smoothness & Bounded Energy",
            "Continuous Flow Field Geodesic Convergence",
            "Sovereign RAG-GFM Quadtree Closure"
        }
    },
    {
        .fourcc_str = "REV3",
        .opcode_signature = 0x52455633,
        .title = "CPMTOMIE-REVIEW-PHASE3-CORPS",
        .theorem_descriptions = {
            "Theorem 1 Proof",
            "Theorem 2 Proof",
            "Theorem 3 Proof",
            "Theorem 4 Proof",
            "Theorem 5 Proof"
        }
    },
    {
        .fourcc_str = "SYNQ",
        .opcode_signature = 0x53594E51,
        .title = "CPMTOMIE-SYNAPSE-CLOSURE-CORPS",
        .theorem_descriptions = {
            "Synapse as strict Morphism Hom(N_i, N_j)",
            "Neural Net Graph Closure (No isolated existence)",
            "Skyrmionic Potential strictly as Synaptic Weight Conductance",
            "Theorem 4 Proof",
            "Theorem 5 Proof"
        }
    },
    {
        .fourcc_str = "MEGA",
        .opcode_signature = 0x4D454741,
        .title = "CPMTOMIE-MEGAMESH-CORPS",
        .theorem_descriptions = {
            "Perron-Frobenius Spectral Radius Stability (rho(W) < 1)",
            "Non-Abelian Gauge Fiber Bundle State Routing",
            "Dissipative Energy Operator & Lyapunov Convergence",
            "Bounded Gossip Multi-Cast Synaptic Transport",
            "Theorem 5 Proof"
        }
    },
    {
        .fourcc_str = "INDC",
        .opcode_signature = 0x494E4443,
        .title = "CPMTOMIE-INDUCTIVE-PROOF-CORPS",
        .theorem_descriptions = {
            "Kleene-Tarski Structural Fixpoint Invariance",
            "Exact Adjoint Matrix State Differentiation",
            "Yul Register Chin-Monopole Lower Clamping",
            "Bernstein Dimension-Free Recurrence Bounding",
            "Theorem 5 Proof"
        }
    },
    {
        .fourcc_str = "TFDS",
        .opcode_signature = 0x54464453,
        .title = "TF-DISTRIBUTE-STRATEGIES-ZORSE-FORMAL-PROVING",
        .theorem_descriptions = {
            "tf.distribute.MirroredStrategy mapped to ZMM ReBAR mirrors",
            "ParameterServerStrategy mapped to WinchesterMQ Channel 18 ring",
            "TPUStrategy AllReduce evaluated as Bessel wave harmonic peace",
            "Distributed convergence protected by BMRC 7/8ths contraction",
            "Theorem 5 Proof"
        }
    },
    {
        .fourcc_str = "TCLS",
        .opcode_signature = 0x54434C53,
        .title = "CPMTOMIE-TOTAL-CLOSURE-CORPS",
        .theorem_descriptions = {
            "All operators closed under Weyl/Lie/Skyrmion ring",
            "Complete negative guarantee of fault absence",
            "Fully executable Curry-Howard witness on disk",
            "Grounded Totient Zero Restitution Sealed",
            "Theorem 5 Proof"
        }
    },
    {
        .fourcc_str = "CADV",
        .opcode_signature = 0x43414456,
        .title = "ADVANCED-CLAYSCAPE-CERAMIC-SCIENCE-CORPS",
        .theorem_descriptions = {
            "Thixotropic Yield Stress Slump Stability",
            "Self-Supporting Overhang Catenary Angle Bounds",
            "Interlocking Joint Firing Tolerance Clearance",
            "Capillary Pore Glaze Vitrification Diffusion",
            "Sovereign Advanced ClayScape Ceramic Seal"
        }
    },
    {
        .fourcc_str = "WVET",
        .opcode_signature = 0x57564554,
        .title = "GFM-WEYL-CLOSURES-VERLET-FET-STANDARDS-CORPS",
        .theorem_descriptions = {
            "Verlet FET Discharge Integration Accuracy",
            "Symplectic Time-Reversal Phase Conservation",
            "Weyl Chamber Reflected Orbit Invariance",
            "Mass-Spring Field-Effect Relaxation Equilibrium",
            "Sovereign GFM Weyl-Verlet Closure"
        }
    },
    {
        .fourcc_str = "CMTS",
        .opcode_signature = 0x434D5453,
        .title = "MULTI-TIMESCALE-HIERARCHICAL-CORPS",
        .theorem_descriptions = {
            "Daily/Weekly/Monthly Cross-Frequency Harmonic Sampling",
            "Horizon-Aware Dynamic Expert Weight Trajectory Adaptation",
            "M5 Store-Item Sparse Summing Matrix Linear Reconciliation",
            "Bottom-Up & Top-Down Hierarchical Coherence Consistency",
            "O(N * log(H)) Linear Memory & Sub-Linear Time Bounds"
        }
    },
    {
        .fourcc_str = "TFCG",
        .opcode_signature = 0x54464347,
        .title = "TF-ALL-DISTRIBUTED-STRATEGIES-ZORSE-CORPUS",
        .theorem_descriptions = {
            "Theorem 1 Proof",
            "Theorem 2 Proof",
            "Theorem 3 Proof",
            "Theorem 4 Proof",
            "Theorem 5 Proof"
        }
    },
    {
        .fourcc_str = "PRCQ",
        .opcode_signature = 0x50524351,
        .title = "PROCESS-LIFECYCLE-AND-CONTRACT-QUALIFICATION",
        .theorem_descriptions = {
            "Theorem 1 Proof",
            "Theorem 2 Proof",
            "Theorem 3 Proof",
            "Theorem 4 Proof",
            "Theorem 5 Proof"
        }
    },
    {
        .fourcc_str = "SKYM",
        .opcode_signature = 0x534B594D,
        .title = "CPMTOMIE-SKYRMION-CORPS",
        .theorem_descriptions = {
            "Homotopy Group pi_2(S^2) Integer Charge Protection",
            "Dzyaloshinskii-Moriya Interaction Energy Minimization",
            "Verlet Soft-Body FET Pulse Current Discharges",
            "Topological Energy Barrier Non-Volatile Plasticity",
            "Theorem 5 Proof"
        }
    },
    {
        .fourcc_str = "UCLS",
        .opcode_signature = 0x55434C53,
        .title = "CPMTOMIE-UNIFIED-CLOSURE-CORPS",
        .theorem_descriptions = {
            "Weyl Algebra Differential Ring Closure",
            "Lie Algebra Jacobi-Identity-Free Bilinear Bracket Closure",
            "Homotopy Topological Winding Invariant Closure",
            "Universal Isomorphic Functorial Equivalence",
            "Theorem 5 Proof"
        }
    },
    {
        .fourcc_str = "HLOG",
        .opcode_signature = 0x484C4F47,
        .title = "HELMHOLTZ-ORDERED-LINEAR-LOGIC-DISPATCHER-CORPS",
        .theorem_descriptions = {
            "Uniform Atomic Exchange Linear Resource Invariance",
            "Non-Commutative Ordered Linear Tensor Product Soundness",
            "Helmholtz Thermodynamic Free Energy Dispatch Minimization",
            "ReBAR Lockless SPSC Linear Queue Concurrency",
            "Uniform Atomic Ordered Linear Logic Dispatcher Closure"
        }
    },
    {
        .fourcc_str = "STNG",
        .opcode_signature = 0x53544E47,
        .title = "CPMTOMIE-STANAG-MESH-CORPS",
        .theorem_descriptions = {
            "Weyl Operator Algebra Packet Preservation",
            "Direct-Memory Synaptic Latency Bound",
            "Acyclic Topology & Priority Queuing",
            "WinchesterMQ SCSI Channel 18 Bus Sync",
            "Theorem 5 Proof"
        }
    },
    {
        .fourcc_str = "TERA",
        .opcode_signature = 0x54455241,
        .title = "CPMTOMIE-TERAMESH-CORPS",
        .theorem_descriptions = {
            "Cotangent Bundle Symplectic Invariance (omega = dq ^ dp)",
            "Geodesic Minimal Path Routing on Metric Tensor g_ij",
            "Phase Space Volume Conservation (div(X) = 0)",
            "Pontryagin Maximum Principle for Optimal Spike Control",
            "Theorem 5 Proof"
        }
    },
    {
        .fourcc_str = "ACID",
        .opcode_signature = 0x41434944,
        .title = "FULL-STACK-ACID-COMPLIANCE-CORPS",
        .theorem_descriptions = {
            "Strict Atomicity (All-or-Nothing Two-Phase Commit)",
            "Galois Field Invariant Consistency modulo MotzkinPrime",
            "Strict Serializable Multi-Version Isolation (MVCC/ReBAR)",
            "Immutable Quadtree .dat.bin Media Block-Ledger Durability",
            "Zero-Flux Shadow Detent Fault Rollback to Totient 0"
        }
    },
    {
        .fourcc_str = "CMEF",
        .opcode_signature = 0x434D4546,
        .title = "CMEF-DSD-MULTIMODAL-EXPERT-PROVING-CORPS",
        .theorem_descriptions = {
            "Strict Forecasting Risk Reduction ΔR > 0",
            "Exact Signal Conservation ||y - sum(y_k)||^2 == 0",
            "Attention-Gated Inter-Expert Covariance Contraction",
            "Intrinsic Shapley Attribution Faithfulness",
            "Bounded Error Growth under Gaussian Perturbation"
        }
    },
    {
        .fourcc_str = "JESC",
        .opcode_signature = 0x4A455343,
        .title = "JES-OBJECTIVE-JOB-CARRY-SKELETON-CORPS",
        .theorem_descriptions = {
            "JES Objective Job Card Deck Ingestion",
            "Objective Job Carry Input Stream Binding",
            "XCOM Backend Relocatable SKELETON Symbol Resolution",
            "XPLSM Active-High Execution State Conduction",
            "Grounded Totient State Preservation Across Step Boundaries"
        }
    },
    {
        .fourcc_str = "BALK",
        .opcode_signature = 0x42414C4B,
        .title = "BALKAN-SPRACHBUND-CLITIC-TYPOLOGY-CORPS",
        .theorem_descriptions = {
            "Balkan Sprachbund Multi-Lingual Structural Invariance",
            "Pronominal Clitic Doubling Surface-to-Deep Bijectivity",
            "Anaphoric Phi-Feature Agreement Functional Projection",
            "Postposed Enclitic Definite Article Inflection Soundness",
            "Universal Cross-Linguistic Typological Category Closure"
        }
    },
    {
        .fourcc_str = "DPLY",
        .opcode_signature = 0x44504C59,
        .title = "CPMTOMIE-GFM-OPERATIONAL-DEPLOYMENT-CORPS",
        .theorem_descriptions = {
            "Real-Time Multi-Modal Telemetry Stream Synchronization",
            "Hogan Bank Participant Deterministic Endowment",
            "Procedural USDA Asset Deformation & Flow Invariance",
            "Subpoena & Recall PKI Hardware Authorization",
            "Sovereign GFM Operational Deployment Engine Closure"
        }
    },
    {
        .fourcc_str = "CPPP",
        .opcode_signature = 0x43505050,
        .title = "CPMTOMIE-CLAY-PHYSICALITY-PLASTICITY-CORPS",
        .theorem_descriptions = {
            "Dual Physicality Mapping Invariance",
            "Virtual Plasticity Non-Newtonian Yield Stress",
            "Viscoelastic Stress Relaxation Time Bounds",
            "Cohesive Boundary Surface Tension Invariance",
            "Sovereign Physical-Virtual Clay Duality Grand Seal"
        }
    },
    {
        .fourcc_str = "CMZB",
        .opcode_signature = 0x434D5A42,
        .title = "CMEF-DSD-TO-ZORSE-HARDWARE-BRIDGE-CORPS",
        .theorem_descriptions = {
            "CMEF Scale Decomposition Mapped to Zorse Bessel J0/J1 Harmonics",
            "Cross-Expert Attention Gating Mapped to SCSI Channel 18 Ring",
            "Signal Conservation Enforced on ReBAR ZMM Vector Buffers",
            "Discrete EDO-22 & Motzkin Prime Galois Arithmetic Mapping",
            "Decomposition Divergence Restitution into Grounded Totient 0"
        }
    },
    {
        .fourcc_str = "CJNR",
        .opcode_signature = 0x434A4E52,
        .title = "CPMTOMIE-NEURON-PROOFS-CORPS",
        .theorem_descriptions = {
            "Categorical Affine Subspace Embedding",
            "Direct Sum / Kronecker Product Commutativity",
            "Truncated Dynamical Invariance & Bounded Depth",
            "Lipschitz Continuous Backpropagation Continuity",
            "WinchesterMQ SCSI Register Gated Mapping"
        }
    },
    {
        .fourcc_str = "GSEAL",
        .opcode_signature = 0x47534541,
        .title = "TOMIC-GENERATIVE-GRAND-SOVEREIGN-MASTER-SEAL",
        .theorem_descriptions = {
            "Full Deep-to-Surface Propositional Semantic Equivalence",
            "ReBAR ZMM Phrase Marker Vector Register Alignment",
            "Totient Zero Ground State Galois Field Modular Arithmetic",
            "WinchesterMQ SCSI Channel 18 Linguistic Hardware Conduction",
            "170-Theorem Grand Sovereign Linguistic-Hardware Master Seal"
        }
    },
    {
        .fourcc_str = "B200",
        .opcode_signature = 0x42323030,
        .title = "BICENTENNIAL-200-THEOREMS-SOVEREIGN-MASTER-SEAL",
        .theorem_descriptions = {
            "Full Compiler-to-Virtual-Hardware Isomorphism",
            "Totient-Galois Thermodynamic Ground State Invariance",
            "ReBAR MVCC Cut-Elimination Durability Invariance",
            "Multi-Modal Physics & Sensor Stream Soundness",
            "200-Theorem Sovereign Bicentennial Master Seal"
        }
    },
    {
        .fourcc_str = "LSEM",
        .opcode_signature = 0x4C53454D,
        .title = "CHOMSKY-FILLMORE-LINGUISTIC-SEMANTICS-CORPS",
        .theorem_descriptions = {
            "Inherent Semantic Feature Lexical Insertion Invariance",
            "Chomsky 1965 Standard Generative Transformational Model",
            "Experiencer, Patient and Locative Semantic Mapping",
            "Active-to-Passive Surface Transformation Invariance",
            "Deep Case Subjectivization Hierarchy Priority Lattice"
        }
    },
    {
        .fourcc_str = "CLUT",
        .opcode_signature = 0x434C5554,
        .title = "CINEMATIC-3D-LUT-SPECTRAL-PROVING-CORPS",
        .theorem_descriptions = {
            "3D-LUT Tetrahedral Continuous Geometric Interpolation",
            "Cinefex Physical Spectral Radiance Reconstruction",
            "Tripartite Shadows/Midtones/Highlights CMEF-Scale Warping",
            "Logarithmic HDR Tone-Curve Clamping without Highlight Clip",
            "Exact Cross-Spectral RGB-to-Thermal Manifold Bijectivity"
        }
    },
    {
        .fourcc_str = "CP5O",
        .opcode_signature = 0x4350354F,
        .title = "CPMTOMIE-5OPERATOR-2LAYER-CLAY-PLAY-SUITE",
        .theorem_descriptions = {
            "Two-Layer Clay Abstraction Duality",
            "Schumpeter Combine Operator Closure",
            "Constituent Decompose Tearing Invariance",
            "Canvas Entropy Bounding via Reduce & Replace",
            "Sovereign 5-Operator Clay Play TPA 0100H Synthesis Grand Seal"
        }
    },
    {
        .fourcc_str = "TFDF",
        .opcode_signature = 0x54464446,
        .title = "STABLE-DIFFUSION-DEEPSEEK-MOONDREAMS-FUSION",
        .theorem_descriptions = {
            "UNet Conv2D Down/Up-sampling & ResNet Residual Blocks",
            "Cross-Attention DeepSeek Text Condition Tensor Alignment",
            "Moondreams Vision Encoder Patch Token Embedding",
            "VAE Latent Autoencoder 8x Spatial Bijective Invariance",
            "DDIM Deterministic Reverse Denoising Invariant Trajectory"
        }
    },
    {
        .fourcc_str = "OPND",
        .opcode_signature = 0x4F504E44,
        .title = "CPMTOMIE-OPEN-DISCOVERY-CORPS",
        .theorem_descriptions = {
            "Grounded algebraic closure (Weyl/Lie/Skyrmion)",
            "Absence of fixed closed-world epistemic stall",
            "Dynamic non-equilibrium trajectory exploration",
            "Infinite generative capacity over finite bounded rules",
            "Theorem 5 Proof"
        }
    },
    {
        .fourcc_str = "CMEX",
        .opcode_signature = 0x434D4558,
        .title = "CMEF-DSD-EXTENDED-INFORMATION-THEORY-CORPS",
        .theorem_descriptions = {
            "Fourier-Initialized Kernel & Periodic Attention Bias",
            "0.5x Learning-Rate Multiplier Trend Branch Damping",
            "Pairwise Jensen-Shannon Diversity Maximization",
            "Sub-Linear O(log(K)) Hierarchical Aggregation Scaling",
            "Cross-Scale Information Asymmetry (Trend-Seasonal Coupling)"
        }
    },
    {
        .fourcc_str = "PRUN",
        .opcode_signature = 0x5052554E,
        .title = "RECURSIVE-SYNTACTIC-TREE-PRUNING-CORPS",
        .theorem_descriptions = {
            "S-Node Recursive Pruning Determinism",
            "Ross Complex NP & Coordinate Island Invariance",
            "Cyclic Node Subjacency Boundary Bounds",
            "S-Bar Complementizer Spec-CP Escape Hatch Gating",
            "Universal Derivation Tree Computational Soundness"
        }
    },
    {
        .fourcc_str = "WSKY",
        .opcode_signature = 0x57534B59,
        .title = "CPMTOMIE-WEYL-SKYRMION-CORPS",
        .theorem_descriptions = {
            "Skyrmionic space as canonical Weyl Algebra A_1 generator",
            "Winding Q mapped to symplectic phase-space commutator",
            "Strictly acting as Synaptic Morphism in Neural Net",
            "Theorem 4 Proof",
            "Theorem 5 Proof"
        }
    },
    {
        .fourcc_str = "CPLY",
        .opcode_signature = 0x43504C59,
        .title = "CPMTOMIE-CLAY-PLAY-GENEPLORE-METAPHOR-INTERFACE",
        .theorem_descriptions = {
            "Geneplore Generative-Exploratory Duality",
            "Direct Manipulation Combine Operator Closure",
            "Direct Manipulation Decompose Facet Orthogonality",
            "Non-Linear Continuous Ideation Momentum Invariance",
            "Sovereign Clay Play TPA 0100H Synthesis Seal"
        }
    },
    {
        .fourcc_str = "CMAC",
        .opcode_signature = 0x434D4143,
        .title = "CPMTOMIE-COMPACT-MESH-CORPS",
        .theorem_descriptions = {
            "Cajal Iteration Finite Subspace Unrolling",
            "Bounded Weight Lipschitz Gradient Stability",
            "WinchesterMQ SCSI Channel 18 Handshake",
            "Theorem 4 Proof",
            "Theorem 5 Proof"
        }
    },
    {
        .fourcc_str = "LEXQ",
        .opcode_signature = 0x4C455851,
        .title = "LINGUISTIC-LEXICON-INTEROP-QUALIFICATION",
        .theorem_descriptions = {
            "Theorem 1 Proof",
            "Theorem 2 Proof",
            "Theorem 3 Proof",
            "Theorem 4 Proof",
            "Theorem 5 Proof"
        }
    },
    {
        .fourcc_str = "STNR",
        .opcode_signature = 0x53544E52,
        .title = "STANAG-4586-DIRECT-RESIDUAL-NETWORK-CORPS",
        .theorem_descriptions = {
            "STANAG 4586 Packet-Switched Direct Residual Identity Skip",
            "Sub-Nanosecond Direct Hardware Ring Skip Routing",
            "Differentiable Multimodal Sensor-Telemetry Stream Fusion",
            "WinchesterMQ SCSI Channel 18 Ring Protocol Binding",
            "Absolute Elimination of Convolutional Gradient Shattering"
        }
    },
    {
        .fourcc_str = "KERM",
        .opcode_signature = 0x4B45524D,
        .title = "CPMTOMIE-KERMIT-STREAM-CORPS",
        .theorem_descriptions = {
            "Standard Kermit MARK (0x01) packet delimiter",
            "Error-free 7-bit / 8-bit clean transport",
            "Strict CRC packet parity validation",
            "Coaxial, LoRa, and SCSI transport interoperability",
            "Theorem 5 Proof"
        }
    },
    {
        .fourcc_str = "TFRT",
        .opcode_signature = 0x54465254,
        .title = "RUNTIME-TENSORFLOW-THEOREMS-ZORSE-CORPS",
        .theorem_descriptions = {
            "Best-Fit with Coalescing (BFC) Fragmentation Freedom",
            "Eager Tracing & Concrete Function AST Compilation Equivalence",
            "TF Serving gRPC Request Latency Bounding (< 1000ns dispatch)",
            "TFX MLMD Artifact Lineage 2-3 Tree Merkle Invariance",
            "Cross-Process RemoteCall SCSI Isolation & Immunity"
        }
    },
    {
        .fourcc_str = "TEDY",
        .opcode_signature = 0x54454459,
        .title = "CPMTOMIE-TEDDY_BEAR-STANAG-CORPS",
        .theorem_descriptions = {
            "Deterministic DNA-to-SSA Mapping",
            "Real-World STANAG 4586 Telemetry Deployment",
            "Recurrent Differentiable Sensor Fusion",
            "Pure C Document Processing Operator Pipeline",
            "Theorem 5 Proof"
        }
    },
    {
        .fourcc_str = "Q250",
        .opcode_signature = 0x51323530,
        .title = "QUARTER-MILLENNIUM-250-THEOREMS-MASTER-SEAL",
        .theorem_descriptions = {
            "Universal Computational Totality & Termination",
            "Lie-Weyl Scenegraph-to-Hardware Isomorphism",
            "Symplectic FET Verlet Physical Conservation",
            "Thermodynamic Helmholtz Free Energy Minimal Dispatch",
            "250-Theorem Sovereign Quarter-Millennium Master Seal"
        }
    },
    {
        .fourcc_str = "WEYL",
        .opcode_signature = 0x5745594C,
        .title = "GFM-WEYL-GROUP-CLOSURE-EQUIVALENCE-CORPS",
        .theorem_descriptions = {
            "Root System Reflection Invariance",
            "Coxeter Complex Orbit Bijectivity",
            "Cartan Subalgebra Weight Space Isomorphism",
            "Fundamental Weyl Chamber Convex Hull Invariance",
            "Sovereign GFM Weyl Closure Equivalence"
        }
    },
    {
        .fourcc_str = "C100",
        .opcode_signature = 0x43313030,
        .title = "CENTENNIAL-100-THEOREMS-SOVEREIGN-SEAL-CORPS",
        .theorem_descriptions = {
            "Wilcoxon Signed-Rank Non-Parametric Significance (p < 0.001)",
            "Logarithmic Transform Multiplicative Decomposition (log(y) = T + S + R)",
            "Residual Strict White Gaussian Noise (WGN) Stationarity & Zero Autocorr",
            "PAC-Bayes Bounded Generalization Risk under Specialization Priors",
            "Complete 100-Theorem Sovereign Centennial Closure & Invariance Seal"
        }
    },
    {
        .fourcc_str = "TFTH",
        .opcode_signature = 0x54465448,
        .title = "TENSORFLOW-FOUNDATIONAL-THEOREMS-ZORSE-CORPS",
        .theorem_descriptions = {
            "XLA HLO Fusion Denotational Equivalence",
            "Reverse-Mode Automatic Diff Adjoint Closure",
            "tf.data Non-Blocking Ring-Buffer Queue Bounding",
            "AutoGraph Static Loop State Invariance",
            "QAT Integer Fixed-Point Residue Conservation"
        }
    },
    {
        .fourcc_str = "ROLL",
        .opcode_signature = 0x524F4C4C,
        .title = "GETTING-THE-BALL-ROLLING-DYNAMICS-CORPS",
        .theorem_descriptions = {
            "Static-to-Kinetic Momentum Transition Invariance",
            "No-Slip Holonomic Rolling Kinematic Constraint",
            "Dynamo Angular Torque Acceleration Coupling",
            "Lyapunov Limit-Cycle Rolling Momentum Stability",
            "Sovereign Ball Rolling System Execution Closure"
        }
    },
    {
        .fourcc_str = "REV2",
        .opcode_signature = 0x52455632,
        .title = "CPMTOMIE-REVIEW-PHASE2-CORPS",
        .theorem_descriptions = {
            "Theorem 1 Proof",
            "Theorem 2 Proof",
            "Theorem 3 Proof",
            "Theorem 4 Proof",
            "Theorem 5 Proof"
        }
    },
    {
        .fourcc_str = "MEDQ",
        .opcode_signature = 0x4D454451,
        .title = "MEDIA-PROTOCOL-STANDARDS-QUALIFICATION",
        .theorem_descriptions = {
            "Theorem 1 Proof",
            "Theorem 2 Proof",
            "Theorem 3 Proof",
            "Theorem 4 Proof",
            "Theorem 5 Proof"
        }
    },
    {
        .fourcc_str = "GIGA",
        .opcode_signature = 0x47494741,
        .title = "CPMTOMIE-GIGAMESH-CORPS",
        .theorem_descriptions = {
            "Uniform Sobolev-Frobenius Bound ||W||_F < C",
            "Poincaré-Hopf Euler Characteristic Topological Invariance",
            "Trivial Betti Number H_1(M) Acyclic Persistence",
            "Hochschild-Serre Lie-Weyl Differential Exactness",
            "Theorem 5 Proof"
        }
    },
    {
        .fourcc_str = "OOKL",
        .opcode_signature = 0x4F4F4B4C,
        .title = "LASER-OOK-LORA-DUAL-MODULATION-CORPS",
        .theorem_descriptions = {
            "Optical On-Off Keying (OOK) Nanosecond Pulse Synthesis",
            "LoRa Chirp Spread Spectrum (CSS) Orthogonal Demodulation",
            "Atmospheric Turbulence & Beam Divergence Spatial Limits",
            "Sub-Millisecond Optical-to-RF Dynamic Link Handover",
            "WinchesterMQ SCSI Channel Physical Transceiver Coupling"
        }
    },
    {
        .fourcc_str = "CPAU",
        .opcode_signature = 0x43504155,
        .title = "CPMTOMIE-SHNEIDERMAN-DIRECT-MANIPULATION-AUTONOMY",
        .theorem_descriptions = {
            "Continuous Visual Representation",
            "Rapid Reversible State Mutation",
            "Cognitive Dissonance Elimination",
            "Human-AI Autonomy Balance Invariance",
            "Sovereign Direct Manipulation TPA 0100H Synthesis Seal"
        }
    },
    {
        .fourcc_str = "BCAT",
        .opcode_signature = 0x42434154,
        .title = "BICARTESIAN-CLOSED-ORDERED-MONAD-CORPS",
        .theorem_descriptions = {
            "Monoidal Bicartesian Closed Category Adjunction",
            "Non-Commutative Linear State Monad Bind Soundness",
            "Categorical Coequalizer Graph Rewrite Confluence",
            "Linear Distributive Tensor Lattice Isomorphism",
            "Sovereign Categorical Semantic Closure"
        }
    },
